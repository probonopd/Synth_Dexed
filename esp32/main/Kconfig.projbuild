## esp32/main/Kconfig.projbuild
```kconfig
menu "FMRack Configuration"

    menu "Audio Settings"
        config FMRACK_SAMPLE_RATE
            int "Sample rate (Hz)"
            default 48000
            range 22050 96000
            help
                Audio sample rate in Hz. Lower values reduce CPU usage.
                Supported: 22050, 44100, 48000, 96000.  Note that 96 kHz
                requires roughly twice the CPU of 48 kHz and may reduce
                polyphony.  Use menuconfig to pick the best compromise for
                your application.

        config FMRACK_BUFFER_SIZE
            int "Audio buffer size (samples)"
            default 256
            range 64 1024
            help
                Number of samples per audio buffer. Smaller values reduce
                latency but increase CPU overhead. 256 is a good default.

        config FMRACK_NUM_MODULES
            int "Number of synth modules"
            default 4
            range 1 8
            help
                Number of simultaneous FM synthesizer modules (parts).
                Each module consumes ~50KB of RAM. With 8MB PSRAM, up to
                8 modules are possible but CPU may be the bottleneck.

        config FMRACK_I2S_NUM
            int "I2S port number"
            default 0
            range 0 1
            help
                I2S peripheral number to use for audio output.
    endmenu

    menu "I2S Pin Configuration"
        config FMRACK_I2S_BCK_PIN
            int "I2S BCK (Bit Clock) GPIO"
            default 6
            range 0 48

        config FMRACK_I2S_WS_PIN
            int "I2S WS (Word Select / LRCLK) GPIO"
            default 7
            range 0 48

        config FMRACK_I2S_DOUT_PIN
            int "I2S Data Out GPIO"
            default 15
            range 0 48

        config FMRACK_I2S_MCLK_PIN
            int "I2S MCLK GPIO (-1 to disable)"
            default -1
            range -1 48
            help
                Master clock output pin. Set to -1 if your DAC generates
                its own clock from BCK (e.g., PCM5102A). Some DACs like
                the UDA1334A require an MCLK signal.
    endmenu

    menu "MIDI Configuration"
        config FMRACK_MIDI_UART_NUM
            int "MIDI UART port number"
            default 1
            range 0 2
            help
                UART peripheral to use for hardware MIDI input.

        config FMRACK_MIDI_RX_PIN
            int "MIDI RX GPIO"
            default 4
            range 0 48

        config FMRACK_MIDI_TX_PIN
            int "MIDI TX GPIO (optional)"
            default 5
            range 0 48

        config FMRACK_MIDI_USB_ENABLE
            bool "Enable USB MIDI (CDC)"
            default y
            help
                Enable MIDI input via USB CDC (serial). MIDI messages
                are received as raw bytes over the USB serial port.

        config FMRACK_MIDI_UDP_ENABLE
            bool "Enable UDP MIDI over Wi-Fi"
            default n
            help
                Enable MIDI input via UDP packets over Wi-Fi.

        config FMRACK_MIDI_UDP_PORT
            int "UDP MIDI port"
            default 50007
            range 1024 65535
            depends on FMRACK_MIDI_UDP_ENABLE
    endmenu

    menu "WLAN and Apple MIDI"
        comment "WLAN credentials are configured at runtime via the captive portal."
        comment "These compile-time options tune the Apple MIDI service name and ports."

        config FMRACK_APPLEMIDI_NAME
            string "Apple MIDI session name"
            default "FMSynthESP"
            help
                The name shown in Audio MIDI Setup → Network on macOS.
                Must be unique on the local network; the mDNS stack
                will append a number automatically if a collision is
                detected (Zeroconf probing, RFC 6762 §9).

        config FMRACK_APPLEMIDI_PORT
            int "Apple MIDI base UDP port"
            default 5004
            range 1024 65534
            help
                Control port (N) and data port (N+1). The default 5004/5005
                are the IANA-registered ports for rtp-midi. Change only if
                you need to run multiple Apple MIDI devices on the same host.

        config FMRACK_CAPTIVE_AP_SSID
            string "Captive portal Access Point SSID"
            default "Synth-Dexed-Setup"
            help
                Open (no password) WLAN network name created when no
                credentials are stored or STA connection fails. Connect
                your phone or laptop to this network to enter credentials.

        config FMRACK_WIFI_SSID
            string "Fallback Wi-Fi SSID (optional)"
            default ""
            help
                Optional compile-time SSID for environments where the
                captive portal cannot be used. Leave blank to rely entirely
                on the runtime captive portal. NVS credentials take priority.

        config FMRACK_WIFI_PASSWORD
            string "Fallback Wi-Fi password (optional)"
            default ""
            help
                Password for FMRACK_WIFI_SSID. Leave blank for open networks.
    endmenu

    menu "Storage"
        config FMRACK_SPIFFS_MOUNT_POINT
            string "SPIFFS mount point"
            default "/spiffs"

        config FMRACK_DEFAULT_PERFORMANCE
            string "Default performance file path"
            default "/spiffs/performance.ini"
            help
                Path to the default performance file loaded at startup.
    endmenu

    menu "Hardware"
        config FMRACK_STATUS_LED_PIN
            int "Status LED GPIO (WS2812 addressable RGB)"
            default 48
            range -1 48
            help
                GPIO for status LED. Set to -1 to disable.
    endmenu

endmenu
```
